## layers/meta-devkit/conf/layer.conf
```bitbake
BBPATH .= ":${LAYERDIR}"
BBFILES += "${LAYERDIR}/recipes-*/*/*.bb ${LAYERDIR}/recipes-*/*/*.bbappend"

BBFILE_COLLECTIONS += "devkit"
BBFILE_PATTERN_devkit = "^${LAYERDIR}/"
BBFILE_PRIORITY_devkit = "6"
LAYERSERIES_COMPAT_devkit = "wrynose"
```
